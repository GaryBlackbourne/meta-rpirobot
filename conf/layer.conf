## conf/layer.conf
```bitbake
# add layer to bitbake path
BBPATH .= ":${LAYERDIR}"

# add recipes to the recipes path
# "where to search for recipes"
BBFILES += "${LAYERDIR}/recipes-*/*/*.bb"
BBFILES += "${LAYERDIR}/recipes-*/*/*.bbappend"

BBFILE_COLLECTION += "meta-rpirobot"
BBFILE_PATTERN_meta-rpirobot = "^${LAYERDIR}/"
BBFILE_PRIORITY_meta-rpirobot = "6"

LAYERDEPENDS_meta-rpirobot = "\
core \
meta \
meta-poky \
meta-yocto-bsp \
meta-skeleton \
meta-raspberrypi \
"

LAYERSERIES_COMPAT_meta-rpirobot = "kirkstone"
```
